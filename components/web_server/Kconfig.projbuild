## components/web_server/Kconfig.projbuild
```kconfig
menu "Web Server Settings"
  config WEB_SERVER_PORT
    int "server port"
    range 1 65535
    default 80 
    help
      Port that the Web Server will bind to
endmenu
```

## components/wifi_controller/Kconfig.projbuild
```kconfig
menu "Wifi Controller Settings"
  config AP_SSID
    string "access point ssid"
    default "Blackout" 
    help
      SSID of Management AP
      
  config AP_PASSWD
    string "access point wifi"
    default "mgtblackout"
    help
      Password of Management AP

  config MAX_CONN
    int "max connections"
    default 1
    help
      Max number of connections of AP
  
  menu "Scan Settings"
    config SCAN_MAX_AP
      int "max scans allowed"
      default 10
      range 1 50
      help
        Max number of AP to be stored in a scan
  endmenu

endmenu
```
